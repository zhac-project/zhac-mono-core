## main/Kconfig.projbuild
```kconfig
# SPDX-FileCopyrightText: 2025-2026 Evgenij Cjura and project contributors
# SPDX-License-Identifier: AGPL-3.0-or-later
#
# mono is fixed to TI ZNP — EZSP and C6 backends are not pulled into
# the build. We still expose the *symbols* the znp_driver guards on
# (#ifdef CONFIG_ZHAC_ZNP_UART_TX_GPIO …) so the same source file
# compiles unchanged against this project's main, with S3-appropriate
# defaults instead of the P4 ones in zhac-main-core/.

menu "ZHAC mono — Zigbee NCP (ZNP)"
    config ZHAC_NCP_ZNP
        bool
        default y
        help
            Always-on in mono. EZSP / C6 paths are intentionally
            unreachable here.

    config ZHAC_ZNP_UART_TX_GPIO
        int "ZNP UART TX GPIO (S3 → CC2652 RX)"
        default 17

    config ZHAC_ZNP_UART_RX_GPIO
        int "ZNP UART RX GPIO (CC2652 TX → S3)"
        default 18

    config ZHAC_ZNP_UART_RST_GPIO
        int "ZNP nRESET GPIO"
        default 19

    config ZHAC_ZNP_UART_BSL_GPIO
        int "ZNP BSL GPIO"
        default 20
endmenu

menu "ZHAC Remote"

config ZHAC_REMOTE_CLIENT_ENABLE
    bool "Enable Remote WSS client (premium feature)"
    default n
    help
        Compile + link the remote_client component. OFF (default):
        zero flash + zero RAM; the mirror call in ws_event_broadcast
        and all api_remote routes compile to nothing.

config ZHAC_REMOTE_RX_BUF_KB
    int "Remote RX buffer (KB, PSRAM)"
    depends on ZHAC_REMOTE_CLIENT_ENABLE
    default 8
    range 4 32

config ZHAC_REMOTE_TX_QUEUE_DEPTH
    int "Remote TX queue depth (events)"
    depends on ZHAC_REMOTE_CLIENT_ENABLE
    default 16
    range 4 64

config ZHAC_REMOTE_PING_INTERVAL_S
    int "WSS ping interval (s)"
    depends on ZHAC_REMOTE_CLIENT_ENABLE
    default 20
    range 5 120

config ZHAC_REMOTE_BACKOFF_MAX_S
    int "Reconnect backoff cap (s)"
    depends on ZHAC_REMOTE_CLIENT_ENABLE
    default 60
    range 5 600

endmenu
```

## sdkconfig.defaults
```kconfig
# SPDX-FileCopyrightText: 2025-2026 Evgenij Cjura and project contributors
# SPDX-License-Identifier: AGPL-3.0-or-later
#
# zhac-mono-core sdkconfig.defaults
# Derived from zhac-net-core defaults with two deliberate changes:
#   1. No OTA — single factory app slot (see partitions.csv).
#   2. No HAP-over-SPI tuning — the dual-chip link is gone, replaced
#      by the in-process mono_bridge shim.
# Everything else stays close to net-core so reused components see
# the same kernel timing, PSRAM mode, and IRAM choices.

CONFIG_IDF_TARGET="esp32s3"

# FreeRTOS @ 1 ms tick — needed by the per-second cron tick in
# simple_rules and by lwIP / WS server timing.
CONFIG_FREERTOS_HZ=1000

# Task watchdog: 10 s ceiling, IDLE0 exempt (Lua + Zigbee main loops
# yield through CPU0 and a brief stall there during NVS commits is
# normal).
CONFIG_ESP_TASK_WDT_EN=y
CONFIG_ESP_TASK_WDT_TIMEOUT_S=10
CONFIG_ESP_TASK_WDT_CHECK_IDLE_TASK_CPU0=n

# PSRAM is mandatory in mono (see PLAN.md). Octal mode @ 80 MHz on S3.
CONFIG_SPIRAM=y
CONFIG_SPIRAM_MODE_OCT=y
CONFIG_SPIRAM_RODATA=y
CONFIG_SPIRAM_ALLOW_BSS_SEG_EXTERNAL_MEMORY=y

# 16 MB flash, QIO. Single factory slot (no OTA partitions) gives
# ~6 MB app + ~6 MB SPIFFS — plenty of headroom for SPA + scripts.
CONFIG_ESPTOOLPY_FLASHSIZE_16MB=y
CONFIG_ESPTOOLPY_FLASHMODE_QIO=y
CONFIG_PARTITION_TABLE_CUSTOM=y
CONFIG_PARTITION_TABLE_CUSTOM_FILENAME="partitions.csv"

# Coredump → flash. (Format/checksum kconfig names changed in IDF v6.0;
# defaults are already ELF + CRC32, so we only need the enable flag.)
CONFIG_ESP_COREDUMP_ENABLE_TO_FLASH=y

# Brownout detector on (DIY rigs often have marginal USB supply).
CONFIG_ESP_BROWNOUT_DET=y

# Stack-canary at end of every task — catches the rule_cron-style
# overflows we hit on dual-chip without needing GDB.
CONFIG_FREERTOS_WATCHPOINT_END_OF_STACK=y
CONFIG_COMPILER_STACK_CHECK_MODE_STRONG=y
CONFIG_FREERTOS_ISR_STACKSIZE=4192
CONFIG_MAIN_TASK_STACK_SIZE=4192

# WS support in esp_http_server.
CONFIG_HTTPD_WS_SUPPORT=y

# Per-core CPU load telemetry for /api/status.
CONFIG_FREERTOS_GENERATE_RUN_TIME_STATS=y
CONFIG_FREERTOS_USE_TRACE_FACILITY=y

# Socket pool: 3 internal httpd + 9 user WS + 2 REST + 2 MQTT = 16.
CONFIG_LWIP_MAX_SOCKETS=16

# CPU @ 240 MHz. APB stays at 80 MHz.
CONFIG_ESP_DEFAULT_CPU_FREQ_MHZ_240=y
CONFIG_ESP_DEFAULT_CPU_FREQ_MHZ=240
CONFIG_ESP32S3_DEFAULT_CPU_FREQ_240=y
CONFIG_ESP32S3_DEFAULT_CPU_FREQ_MHZ=240

# Performance tuning (trades ~150 KB flash + ~32 KB IRAM for measurable
# wins across CPU, lwIP, mbedtls — same matrix as net-core).
CONFIG_COMPILER_OPTIMIZATION_PERF=y
CONFIG_MBEDTLS_COMPILER_OPTIMIZATION_PERF=y
CONFIG_LWIP_IRAM_OPTIMIZATION=y
CONFIG_ESP_WIFI_IRAM_OPT=y
CONFIG_ESP_WIFI_RX_IRAM_OPT=y
CONFIG_LWIP_TCP_SND_BUF_DEFAULT=11520
CONFIG_LWIP_TCP_WND_DEFAULT=11520

# TLS cert bundle for any HTTPS clients (Telegram gateway, future
# webhooks). Optional but matches net-core parity.
CONFIG_MBEDTLS_CERTIFICATE_BUNDLE=y

# Zigbee radio — TI ZNP over UART. S3 GPIO defaults; override in
# menuconfig if the actual board wires the CC2652 differently. (See
# main/Kconfig.projbuild for the symbol declarations — keeping them
# explicit here freezes the default and documents the wiring.)
CONFIG_ZHAC_NCP_ZNP=y
CONFIG_ZHAC_ZNP_UART_TX_GPIO=17
CONFIG_ZHAC_ZNP_UART_RX_GPIO=18
CONFIG_ZHAC_ZNP_UART_RST_GPIO=19
CONFIG_ZHAC_ZNP_UART_BSL_GPIO=20
```
